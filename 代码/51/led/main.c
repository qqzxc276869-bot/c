#include <reg52.h>
#include <intrins.h>

// 数据类型的重命名
typedef unsigned char u8;       // 0~255
typedef unsigned int  u16;      // 0~65535


// ======================================================
// 延时函数
// ======================================================

// ten_us = 1，代表10us
void delay_us(u16 ten_us)
{
    while(ten_us--);
}


// ms = 1，代表1ms
void delay_ms(u16 ms)
{
    u16 i,j;

    for(i=ms;i>0;i--)
        for(j=110;j>0;j--);
}


// ======================================================
// 矩阵按键
// ======================================================

// 封装矩阵按键：线翻转法
u8 key_flix_scan()
{
    u8 keynumber=0;

    // 先设置所有行线为低，列线全部为高
    // 0000 1111
    P1=0X0F;

    if(P1!=0X0F)
    {
        // 消抖
        delay_ms(10);

        // 再次检测
        P1=0X0F;

        // 检测列线
        switch(P1)
        {
            case 0X07:
                keynumber=1;
                break;

            case 0X0B:
                keynumber=2;
                break;

            case 0X0D:
                keynumber=3;
                break;

            case 0X0E:
                keynumber=4;
                break;
        }


        // ==================================================
        // 再翻转
        // 所有列线为低，行线全部为高
        // 1111 0000
        // ==================================================

        P1=0XF0;

        // 检测行线
        switch(P1)
        {
            case 0X70:
                keynumber=keynumber;
                break;

            case 0XB0:
                keynumber=keynumber+4;
                break;

            case 0XD0:
                keynumber=keynumber+8;
                break;

            case 0XE0:
                keynumber=keynumber+12;
                break;
        }


        // =================================================
        //
        // 现在不等待松手，直接返回当前按键。
        // ==================================================
    }

    return keynumber;
}


// ======================================================
// 595芯片
// ======================================================

// 定义595芯片的引脚
sbit SER=P3^4;       // 串行数据输入
sbit rCLK=P3^5;      // 存储寄存器时钟
sbit SRCLK=P3^6;     // 移位寄存器时钟


// ======================================================
// 595：串入并出
// ======================================================

void hc595_Write_data(u8 byte)
{
    u8 i;

    for(i=0;i<8;i++)
    {
        // 准备好高位数据
        SER=byte>>7;

        // 左移一位
        byte<<=1;

        // 移位寄存器时钟
        SRCLK=0;
        SRCLK=1;
    }

    // 存储寄存器时钟
    rCLK=0;
    rCLK=1;
}


// ======================================================
// LED点阵图案
// ======================================================

u8 gled_dz_rows[8]=
{
    0x00,
    0x10,
    0x20,
    0x7C,
    0x7C,
    0x20,
    0x10,
    0x00
};


// ======================================================
// LED点阵列线
// ======================================================

u8 gled_dz_cols[8]=
{
    0x7F,
    0xBF,
    0xDF,
    0xEF,
    0xF7,
    0xFB,
    0xFD,
    0xFE
};


// ======================================================
// 向左移动
// ======================================================

void move_left(u8 arr[],int len)
{
    u8 i;
    u8 temp=arr[0];

    for(i=0;i<len-1;i++)
    {
        arr[i]=arr[i+1];
    }

    arr[len-1]=temp;
}


// ======================================================
// 向右移动
// ======================================================

void move_right(u8 arr[],int len)
{
    u8 i;
    u8 temp=arr[len-1];

    for(i=len-1;i>0;i--)
    {
        arr[i]=arr[i-1];
    }

    arr[0]=temp;
}


// ======================================================
// 向上移动
// ======================================================

void move_up(u8 arr[],int len)
{
    u8 i;

    for(i=0;i<len;i++)
    {
        arr[i]=_crol_(arr[i],1);
    }
}


// ======================================================
// 向下移动
// ======================================================

void move_down(u8 arr[],int len)
{
    u8 i;

    for(i=0;i<len;i++)
    {
        arr[i]=_cror_(arr[i],1);
    }
}


// ======================================================
// LED点阵刷新
// ======================================================

void refresh_led()
{
    u8 i;

    for(i=0;i<8;i++)
    {
        // 先关闭上一列
        hc595_Write_data(0x00);

        // 发送当前列的数据
        hc595_Write_data(gled_dz_rows[i]);

        // 选择当前列
        P0=gled_dz_cols[i];

        // 延时
        delay_ms(2);
    }

    // 关闭点阵
    P0=0xFF;
}


// ======================================================
// 主函数
// ======================================================

void main()
{
    u8 keynumber=0;

    // 【修改】
    // 移动速度计数器
    u8 count=0;


    while(1)
    {
        // ==================================================
        // 获取当前按键
        // ==================================================

        keynumber=key_flix_scan();


        if(keynumber==0)
        {
            count=0;
        }
        else
        {         
            count++;

            if(count>=6)
            {
                count=0;


                // ==================================================
                // 根据按键方向移动
                // ==================================================

                switch(keynumber)
                {
                    case 1:

                        // P1.7对应的按键
                        // 向左移动
                        move_left(gled_dz_rows,8);

                        break;


                    case 2:

                        // 向右移动
                        move_right(gled_dz_rows,8);

                        break;


                    case 3:

                        // 向上移动
                        move_up(gled_dz_rows,8);

                        break;


                    case 4:

                        // 向下移动
                        move_down(gled_dz_rows,8);

                        break;
										/*case 5:

                        // 向下移动
                        move_down(gled_dz_rows,8);
												move_down(gled_dz_rows,8);

                        break;
										
                }
            }
        }


        // ==================================================
        // 持续刷新LED点阵
        // ==================================================

        refresh_led();
    }
}